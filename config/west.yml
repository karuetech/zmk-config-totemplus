## config/west.yml
```yaml
manifest:
  remotes:
    - name: zmkfirmware
      url-base: https://github.com/zmkfirmware
    - name: joaopedropio                          # <--- add these
      url-base: https://github.com/joaopedropio   # <---
    - name: janpfischer
      url-base: https://github.com/janpfischer
  projects:
    - name: zmk
      remote: zmkfirmware
      revision: main
      import: app/west.yml
    - name: snake-module                          # <--- and these
      remote: joaopedropio                        # <---
      revision: master                            # <---
    - name: zmk-dongle-screen
      remote: janpfischer
      revision: main
  self:
    path: config
```
